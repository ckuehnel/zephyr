## drivers/display/Kconfig
```kconfig
# Kconfig - Display drivers

#
# Copyright (c) 2017 Intel Corporation
#
# SPDX-License-Identifier: Apache-2.0
#

menuconfig DISPLAY
	bool "Display Drivers"
	help
	  Enable display drivers

if DISPLAY

config SYS_LOG_DISPLAY_DRIVER_LEVEL
	int "Display driver log level"
	depends on SYS_LOG
	default 0
	help
	  Sets log level for display drivers.

	  Levels are:

	  - 0 OFF, do not write

	  - 1 ERROR, only write SYS_LOG_ERR

	  - 2 WARNING, write SYS_LOG_WRN in addition to previous level

	  - 3 INFO, write SYS_LOG_INF in addition to previous levels

	  - 4 DEBUG, write SYS_LOG_DBG in addition to previous levels

source "drivers/display/Kconfig.microbit"

source "drivers/display/Kconfig.ili9340"

source "drivers/display/Kconfig.ssd1306"

endif # DISPLAY
```

## drivers/display/Kconfig.ssd1306
```kconfig
# Kconfig - SSD1306 display controller configuration options

#
# Copyright (c) 2018 Phytec Messtechnik GmbH
#
# SPDX-License-Identifier: Apache-2.0
#

menuconfig SSD1306
	bool "SSD1306 display driver"
	depends on I2C
	help
	  Enable driver for SSD1306 display driver.

if SSD1306

if !HAS_DTS_I2C_DEVICE

config SSD1306_DEV_NAME
	string "SSD1306 device name"
	  default "SSD1306"

config SSD1306_I2C_ADDR
	hex "I2C address for SSD1306 controller"
	default "0x3c"
	range 0x3c 0x3d
	help
	  I2C address of the SSD1306 controller.

	  0x3c: SA connected GND
	  0x3d: SA connected VDD

config SSD1306_I2C_MASTER_DEV_NAME
	string "I2C master where SSD1306 is connected"
	default "I2C_0"
	help
	  The I2C master device's name where the SSD1306 controller is connected.

endif # !HAS_DTS_I2C_DEVICE

config SSD1306_DEFAULT_CONTRAST
	int "SSD1673 default contrast"
	default 128
	range 0 255
	help
	  SSD1673 default contrast.

choice
	prompt "Display controller type"
	default SSD1306_DEFAULT
	help
	  Specify the type of the controller.

config SSD1306_DEFAULT
	bool "Default SSD1306 controller"

config SSD1306_SH1106_COMPATIBLE
	bool "Enable SH1106 compatible mode"

endchoice

endif #SSD1306
```

## drivers/display/Kconfig.ssd1673
```kconfig
# Kconfig - SSD1673 display controller configuration options

#
# Copyright (c) 2018 Phytec Messtechnik GmbH
#
# SPDX-License-Identifier: Apache-2.0
#

menuconfig SSD1673
	bool "SSD1673 display driver"
	depends on SPI
	help
	  Enable driver for SSD1673 display driver.

if SSD1673

config SSD1673_DEV_NAME
	string "SSD1673 device name"
	  default "SSD1673"

config SSD1673_SPI_DEV_NAME
	string "SPI master where SSD1673 is connected"
	default "SPI_0"
	help
	  Specify the device name of the SPI master device to which SSD1673 is
	  connected.

config SSD1673_SPI_SLAVE_NUMBER
	int "SPI Slave number where SSD1673 is connected"
	default 0
	help
	  The number of the slave on the host controller to which SSD1673 is
	  connected.

config SSD1673_SPI_FREQ
	int "SPI Frequency"
	default 4000000
	help
	  Frequency to be used to communicate with the SSD1673.

config SSD1673_SPI_GPIO_CS
	bool "Manage SPI CS through a GPIO pin"
	help
	  Manage SPI CS through a GPIO pin

config SSD1673_SPI_GPIO_CS_DRV_NAME
	string "SPI CS GPIO controller port name"
	depends on SSD1673_SPI_GPIO_CS
	help
	  SPI CS GPIO controller port name

config SSD1673_SPI_GPIO_CS_PIN
	int "SPI CS GPIO controller pin"
	default 0
	depends on SSD1673_SPI_GPIO_CS
	help
	  SPI CS GPIO controller pin

config SSD1673_RESET_GPIO_PORT_NAME
	string "Reset GPIO controller port name"
	default "GPIO_0"
	help
	  GPIO controller where the interrupt pin is attached to.

config SSD1673_RESET_PIN
	int "SSD1673 Reset pin"
	default 0
	help
	  SSD1673 reset pin.

config SSD1673_DC_GPIO_PORT_NAME
	string "Data/Command GPIO controller port name"
	default "GPIO_0"
	help
	  GPIO controller where the Data/Command pin is attached to.

config SSD1673_DC_PIN
	int "SSD1673 Data/Command pin"
	default 1
	help
	  SSD1673 Data/Command pin.

config SSD1673_BUSY_GPIO_PORT_NAME
	string "Busy GPIO controller port name"
	default "GPIO_0"
	help
	  GPIO controller where the Busy pin is attached to.

config SSD1673_BUSY_PIN
	int "SSD1673 Busy pin"
	default 1
	help
	  SSD1673 Busy pin.

config SSD1673_ORIENTATION_FLIPPED
	bool "SSD1673 orientation flipped"
	help
	  SSD1673 orientation flipped.

choice
	prompt "EPD display"
	default SSD1673_EPD_GDE0213B1
	help
	  Specify the type of EPD connected to the SSD1673 controller.

config SSD1673_EPD_GDE0213B1
	bool
	prompt "GDE0213B1 2.13\""

endchoice

endif #SSD1673
```

## subsys/fb/Kconfig
```kconfig
# Kconfig - frame buffer configuration options

#
# Copyright (c) 2018 Phytec Messtechnik GmbH
#
# SPDX-License-Identifier: Apache-2.0
#

menu "Framebuffer"

config CHARACTER_FRAMEBUFFER
	bool "Character framebuffer for monochrome dot matrix displays"
	help
	  Character framebuffer for monochrome dot matrix displays.

if CHARACTER_FRAMEBUFFER

config CHARACTER_FRAMEBUFFER_USE_DEFAULT_FONTS
	bool "Use default fonts"
	default y
	help
	  Use default fonts.

config SYS_LOG_FRAMEBUFFER_LEVEL
	int "Display framebuffer log level"
	depends on SYS_LOG
	default 0
	help
	  Sets log level for display framebuffer.

	  Levels are:

	  - 0 OFF, do not write

	  - 1 ERROR, only write SYS_LOG_ERR

	  - 2 WARNING, write SYS_LOG_WRN in addition to previous level

	  - 3 INFO, write SYS_LOG_INF in addition to previous levels

	  - 4 DEBUG, write SYS_LOG_DBG in addition to previous levels

endif

endmenu
```
